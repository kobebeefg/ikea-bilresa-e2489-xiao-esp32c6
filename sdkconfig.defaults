## sdkconfig.defaults
```kconfig
CONFIG_ZB_ENABLED=y
CONFIG_ZB_EXAMPLE_PRIMARY_CHANNEL=11
CONFIG_ESP_CONSOLE_USB_SERIAL_JTAG=y
CONFIG_ESPTOOLPY_FLASHSIZE_4MB=y
CONFIG_PARTITION_TABLE_CUSTOM=y
CONFIG_PARTITION_TABLE_CUSTOM_FILENAME="partitions.csv"
```
